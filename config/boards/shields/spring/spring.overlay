/*
 * Copyright (c) 2021 The ZMK Contributors
 *
 * SPDX-License-Identifier: MIT
 */

#include "spring.dtsi"

&kscan0 {
    col-gpios
                = <&pro_micro  4 GPIO_ACTIVE_HIGH>  // KC0,  <4  0 &gpio0 20 0>	/* D4/A6 */
                , <&pro_micro  3 GPIO_ACTIVE_HIGH>  // KC1,  <3  0 &gpio0 17 0>	/* D3 */
                , <&gpio0 10     GPIO_ACTIVE_HIGH>  // KC2
                , <&pro_micro  9 GPIO_ACTIVE_HIGH>  // KC3,  <9  0 &gpio1  6 0>  /* D9/A9 */
                , <&pro_micro  7 GPIO_ACTIVE_HIGH>  // KC4,  <7  0 &gpio0  9 0>	 /* D7 */
                //, <&pro_micro 10 GPIO_ACTIVE_HIGH>  // KC5,  <10 0 &gpio1  4 0>	 /* D10/A10 */
                , <&pro_micro  0 GPIO_ACTIVE_HIGH>  // KC5,  <0  0 &gpio0  8 0>	 /* D0 */
                , <&pro_micro 18 GPIO_ACTIVE_HIGH>  // KC6,  <18 0 &gpio0  2 0>  /* D18/A0 */
                , <&gpio0 5      GPIO_ACTIVE_HIGH>  // KC7
                , <&pro_micro  1 GPIO_ACTIVE_HIGH>  // KC8,  <1  0 &gpio0  6 0>	 /* D1 */
                , <&pro_micro 16 GPIO_ACTIVE_HIGH>  // KC9,  <16 0 &gpio0 28 0>	 /* D16 */
                , <&gpio0 26     GPIO_ACTIVE_HIGH>  // KC10
                , <&pro_micro 19 GPIO_ACTIVE_HIGH>  // KC11, <19 0 &gpio0 29 0>	 /* D19/A1 */
                , <&gpio1 13     GPIO_ACTIVE_HIGH>  // KC12
                , <&pro_micro 14 GPIO_ACTIVE_HIGH>  // KC13, <14 0 &gpio0  3 0>	 /* D14 */
                , <&gpio1 11     GPIO_ACTIVE_HIGH>  // KC14
                ;
};

&left_encoder {
	status = "okay";
};
&right_encoder {
	status = "okay";
};


