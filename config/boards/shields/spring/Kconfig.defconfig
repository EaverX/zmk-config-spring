## config/boards/shields/spring/Kconfig.defconfig
```kconfig
# Copyright (c) 2021 The ZMK Contributors
# SPDX-License-Identifier: MIT

config ZMK_BLE
	default y

config ZMK_USB
	default y

config ZMK_HID_REPORT_TYPE_HKRO
	default y

	
if SHIELD_SPRING

config ZMK_KEYBOARD_NAME
    default "Spring"

endif
```

## config/boards/shields/spring/Kconfig.shield
```kconfig
# Copyright (c) 2021 The ZMK Contributors
# SPDX-License-Identifier: MIT

config SHIELD_SPRING
    def_bool $(shields_list_contains,spring)
```
